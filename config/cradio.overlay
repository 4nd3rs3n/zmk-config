/*
 * Copyright (c) 2020 The ZMK Contributors
 *
 * SPDX-License-Identifier: MIT
 */


&vbatt {
    output-ohms = <806000>;      // R2 (bottom)
    full-ohms   = <7657000>;     // R1 + R2 (top + bottom)
};



