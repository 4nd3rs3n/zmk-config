/ {
    aliases {
        vbatt = &vbatt;
    };
};

&adc {
    status = "okay";
};

&vbatt {
    compatible = "zmk,battery-voltage-divided";
    status = "okay";
    io-channels = <&adc 0>;

    // Fine-tuned for your Tenstar clone
    division-microvolt = <6620>;

    // LiPo battery range
    full-millivolts = <4200>;
    discharge-millivolts = <3300>;
};
