/*
 * Copyright (c) 2020 The ZMK Contributors
 *
 * SPDX-License-Identifier: MIT
 */

#include "cradio.dtsi"

&vbatt {
    output-ohms = <800000>;         // bottom resistor (ADC → GND), keep as-is
    full-ohms = <10000000>;          // scale factor ~9.95 → full-ohms = output-ohms * scale / (1 - 1/scale)
};


