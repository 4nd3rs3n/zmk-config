/*
 * Copyright (c) 2020 The ZMK Contributors
 *
 * SPDX-License-Identifier: MIT
 */

#include "cradio.dtsi"

&vbatt {
    output-ohms = <806000>;      // R2 (bottom)
    full-ohms   = <8040855>;     // R1 + R2 (top + bottom) -- adjusted for left half
};


