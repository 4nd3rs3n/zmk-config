/*
 * Copyright (c) 2020 The ZMK Contributors
 *
 * SPDX-License-Identifier: MIT
 */

#include "cradio.dtsi"

&default_transform {
    col-offset = <17>;
};

&vbatt {
    output-ohms = <806000>;
    full-ohms   = <9378881>;   // right half — adjusted so ~361 mV -> ~4200 mV (100%)
};




